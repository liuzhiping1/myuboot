## u-boot-2016.03/board/samsung/zcz2416/Kconfig
```kconfig
if TARGET_ZCZ2416

config SYS_BOARD
	default "zcz2416"

config SYS_VENDOR
	default "samsung"

config SYS_SOC
	default "s3c24xx"

config SYS_CONFIG_NAME
	default "zcz2416"

endif
```

## u-boot-2016.03/configs/zcz2416_defconfig
```kconfig
CONFIG_ARM=y
CONFIG_TARGET_ZCZ2416=y
CONFIG_SYS_PROMPT="ZCZ2410 # "
CONFIG_SUPPORT_SPL=y
CONFIG_SPL=y
# CONFIG_CMD_SETEXPR is not set
```
